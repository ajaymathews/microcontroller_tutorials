/*
 * SPI_TEST.c
 *
 * Created: 27-06-2019 12:48:43
 * Author : [Developer]
SPI IS FASTER(TWICE) THAN I2C, AND THE NO COOMPLEX ARSSING LIKE IN I2C. 
 
 master:
 ss line must be progmmed in s/w, must be held high for master transmission,if pulls to low it will be interpretted as a slave and mstr bit is set to zero from one.
 writing a byte to the SPI Data Register starts the SPI clock generator
 spdr is the data reg,
 
 
PINS:	 MOSI(SET AS O/P),SCK(SET AS O/P),SS:USER DEFINED
		 MISO:INPUT
BITS:	 SPCR:SPE,MSTR,SPR0->1   
		 SPDR=DATA;
		 WHIILE(!(SPSR&(1<<SPIF)));  :FROM EXAMPLE

 
 slave:
 data will not be shifted till untill ss pin is low(spi is active),whwn ss pin is high will not recieve data and spi logic is reset and clear all data in shift reg 
 dat trnsmitted by pulling low on ss pin on slave and trnsmission ended by pulling high on ss pin

PINS:	 MOSI,SCK,SS:INPUT
		 MISO(SET AS O/P):USER DEFINED

BITS:	 SPCR:SPE->1
		 WHILE(!(SPSR&(1<<SPIF)));  :TILL RECEPTION IS COMPLETE
		 return SPDR;

 
 
->The last incoming byte will be kept in the Buffer Register for later use
ateach shifting spif is set(in both slave and master)


spcr:spie->1:if spif is set interrpt is genrted
	:spe->1: spi enable
	:dord->1:lb trnsmitted first else msb first
	:mstr->1:master mode else slave
	:cpha,cpol determines leading edge and falling edge 
	:pi2x,spir1,spr0 set the sck fq
	page:177

spsr:spif:interrpt flg/set when trnsfer is complted or master ss pin is set to low
	:wcol:is set if data is written to spdr
	spi2x->1:spi trnsmissn speed is doubled in mastr mode

  
 */ 
#define F_CPU 8000000
#define BAUD  9600
#define NORMAL_BAUD  ((F_CPU/16/BAUD)-1) //for normal mode asynchronus operation

#include <avr/io.h>
#include <util/delay.h>




/************ UART DEFENITIONS *************/


void uart_transmit_set()
{
	UBRR0=NORMAL_BAUD;											//SETTING THE BAUD RATE REGISTERS

	UCSR0B|=(1 << TXEN0);										//enabling transmitter by overidinng normal port operation
	UCSR0C=((1 << UCSZ01)|(1 << UCSZ00));						//8bit frame in reciver and transmitter use
}

void uart_char_send(char buffer)
{
	UDR0=buffer;
	while(!(UCSR0A&1<<UDRE0));										//wait for the data registr to empty.
}

void uart_string_send(char *buffer_ptr)
{
	while(*buffer_ptr!='\0')
	{
		uart_char_send(*buffer_ptr);
		buffer_ptr++;
	}
}



/************ SPI MASTER DEFENITIONS *************/


void spi_master_init()
{
DDRB|=(1<<PORTB3)|(1<<PORTB5);									//mosi,sck pin as output
SPCR=0X51;//((1<<SPE)|(1<<MSTR)|(1<<SPR0));							//ENABLES SPI,MASTER(clock will be generated by the master to slave) AND SET SCK FQ TO FOSC/16	
SPSR=0X00;
}

void spi_master_char_send(char data_char)
{	
	SPDR=data_char;												//placing data to the spdr reg, msb first
	while(!(SPSR&(1<<SPIF)));									//wait till transfer is complted
}

void spi_master_string_send(char *string_ptr)
{
	while(*string_ptr!='\0')
	{
	spi_master_char_send(*string_ptr);
	string_ptr++;	
	_delay_ms(100);
	}	
	//return;
}



/************ SPI SLAVE DEFENITIONS *************/


void spi_slave_init()
{
	DDRB|=1<<PORTB4;												//SET MISO AS OUTPUT, ALL ELSE AS INPUT
	PORTB=~(1<<PORTB3);                                 //B3,WHICH IS MOSI IS ASSIGNED ZERO , BCZ THERE IS A TENDENCY THAT PIN ,
												        //SETS HIGH SOMEHOW, BUT IN SOME CASES IT IS NOT.
	
	SPCR=((1<<SPE)|(1<<SPR0));							//ENABLES SPI,SPRO TO SET F0SC/16
}

char spi_slave_recieve()
{	
while(!(SPSR&(1<<SPIF)));										//TILL RECEPTION IS COMPLETE	
																//uart_char_send(SPDR);
return SPDR;
}

char *spi_slave_string_recieve(char string_data[100])			//recievs the array from main as array
{
	//char string_data[100];
	int i=-1; //it is set to -1 , bcz initially i++ is executed for do while working.
	do
	{
		i++;
		string_data[i]=spi_slave_recieve(); //charctr is recivd to string_data each by each.
		uart_char_send(string_data[i]);
		//uart_string_send("message");
		if((string_data[i]=='\r')||(string_data[i]=='.')||(string_data[i]==' '))  //'\r is the checking condition for new line
		{
			
			string_data[i]='\0';   //assign last letter as \0 to exit reception
			break;            //will work without this break because the while in do while exit whn '\0' comes
		}
		
	}while(string_data[i]!='\0');  //is the checking condition for ending of a string
//uart_string_send("OUTSIDE THE WHILE IN SLAVE");
//uart_string_send(string_data);
	return (string_data);
}





/************ MAIN DEFENITIONS *************/

int main(void)
{
	
	DDRD&=~(1<<PORTD0);
	if(PIND==0x01)										 //IF HIGH VALUE(1) IS APPLIED TO THE D0 IN AVR, IT BCMZ THE MASTER
	{
		char data_buffer[]="aBCDEFGHIJKLMNOP";
		spi_master_init();
		_delay_ms(100);
		while (1)
		{
			spi_master_string_send(data_buffer);
			_delay_ms(100);
		}
	}
	else													//IF LOW VALUE(0) IS APPLIED TO THE D0 IN AVR, IT BCMZ THE MASTER
	{
		spi_slave_init();
		uart_transmit_set();
		char *recieve_string;
		char storge_string[100];
																		//uart_string_send("HELLO");
		while (1)
		{
			while(!(SPSR&(1<<SPIF)));											//TILL RECEPTION IS COMPLETE
																			//uart_char_send(SPDR);
			char c= SPDR;
			uart_char_send(c);
																			//recieve_string=spi_slave_string_recieve(storge_string);
																		//uart_string_send("DONE");
																		//uart_string_send(storge_string);
																		//	_delay_ms(100);
		}
		
	}
	
}

