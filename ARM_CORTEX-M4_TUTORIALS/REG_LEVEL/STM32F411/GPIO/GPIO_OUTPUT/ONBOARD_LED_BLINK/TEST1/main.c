/*
STEPS:
1)SELECT THE FOLDER FOR PROJECT,  NAME ANYTHING U WANT
2)CHOOSE THE BOARD,OR THE DEVICE  :STM32F411VETx
3)FROM CMSIS ,TICK CORE, FROM DEVICE TICK STARTUP
4)CLICK OPTION FOR TARGET,UNDER DEBUG TICK RESET&RUN
5)THEN FROM PROJECT -> TARGER(ENAME IF U WnT) ->RENAME SOURCE_GROUP TO APPLICATION
  FROM IT CREATE A NEW FILE -> MAIN.C (WRITE YOUR CODE IN IT)
	ADD THIS MAIN TO THE APPLICATION

ARM REGISTERS CAN BE VIEWED IN THE DEBUG MODE IN THE KEIL IDE, THEN THE REGISTERS ADDRESS / SP ADDRESS 
IS COPIED AND FROM VIEW CLICK ON MEMORY WINDOW AND COPY THUS ADDRESS SHOWS DETAILED VIEW OF MEMORY.
USED TO DEBUG 

CODING:
-CLOCK OF THE PINS IS CONNECTED TO AHB100 MHZ BUS.(FROM DATA SHEET)(PGE 15)
-SEARCH FOR AHB1 REGISTER IN REFERENCE MANUAL, FIND THE AHB1 ENABLE REGISTER TO ENABLE CLOCK ACCESS TO PORTS.
  BIT 3 OF RCC_AHB1ENR REG ENABLE CLOCK ACESS IN PORT D(PGE 114)
=>REG:(RCC_AHB1ENR)
    BIT 3=1:D PORT ENBLE
         =0:D PORT DISABLE

-SEARCH FOR MODER , GPIO MODE REGISTER
  WHICH IS A 32BIT REGISTER, 16 MODES ARE AVAILBLE EACH MODE IS EACH PINS SUCH THAT, MODE0 IS PIN1, MODE1 IS PIN2.ETC..
  FOR A SINGLE MODE 4 COMBINATION OF BIT IS POSSIBLE,
  00:INPUT
  01:OUTPUT
  10:ALTERNTE FUNCTN
  11:ANALOG MODE
=>  REG:GPIOx_MODER(x is the port)

-OUTPUT DATA REGISTER ODR, SEARCH FOR IT.
  32 BIT REGISTER WITH 16 BITS FOR SETTING OUTUPT FOR 16 PINS

GPIO OUTPUT STEPS
-ENABLE THE CLOCK ACCESS TOTHE CORRESPONDING PORTS USING:ADB1ENR REG
-SET THE PINS AS OUTPUT:MODER REG
-SET THE PIN AS HIGH:ODR

FOR DELAY WE USE A SYSTICK TIMER, IT EXISTS ALL CORTEX CONTROLLERS , EVN IN BOARD
USING CMSIS API WE COULD ACCESS SYSTICK TIMER
-THIS IS DONE BY COUNTIG THE TICK AFTR THE DELAY FN IS CALLED
 IF THAT COUNT REACHES THE DELAY VALUE,THE CONTROL EXISTS FROM DELAY.



EXCEPTION:
WHEN THE PROCESSOR TAKES AN EXCEPTION, THE PROCESSOR PUSHES INFORMATION ONTO THE CURRENT STACK, CALLED AS STACKING. 
AND THE STRUCTURE OF EIGHT DATA WORDS IS REFERRED AS THE STACK FRAME.
WHEN USING FLOATING-POINT ROUTINES THE CORTEX-M4 PROCESSOR AUTOMATICALLY STACKS, WHICH IS A LONG EXCEPTION FRAME,
BUT WHEN IT IS NOT SELECTED FROM OPTION->FLOATING POINT HARDWRE ->NOT USED, THE EXCEPTION FRAME REDUCES
WHEN EACH EXCEPTION OCCURS CURRENT STATUS IS PUSHED TO THESE REG(R0,R1,R2,R3,R12,[R14]LR,[R15]PC,xPSR)[ORDER AS FROM LOW TO HIGH]
THESE IS STORED IN STACK AUTOATICALLY AT EVERY EXCEPTION.

USING THE MEMORY VIEW OF THE SP GIVES THE ARRANGEMENT OF STACK AS LIKE THE ORDER OF REGISTERS ABOVE MENTIONED.

WHEN AN EXCEPTION IS EXECUTED THE ADDRESS OF PROCESS THAT TAKES PLACEING IS STORED TO THE PC, SINCE IT IS A REG FOR
NEXT EXECUTING CODE ADDRESS STORAGE. IF WE CAN CHANGE THAT ADDRESS IN THE PC, BEFORE THE EXITING FROM ISR, WE COULD 
MAKE THE CONTROLLER TO EXECUTE OUR NEW MODIFIED CODE.

ACTUALLY IDEA IS TO PUT A BREAK POINT ON THE PART SUCH AS IN THIS CASE  '++TICK', THUS THE EXECUTION STOPS THERE.
AND IN THE PGM COUNTER, WHICH WHEN CHECKING THE ADDRESS OF SP TO THE VIEW MEMORY , THE SEVENTH FROM THE TOP IS THE PC, 
WHICH IS MENTIONED ABOVE, AND THIS PC NOW CONTAINS THE ADDRESS OF STATEMENT AFTER THE '++TICK' THE COMPILER EXECUTES,
THUS WE NEED TO FIND THE ADDRESS OF OUR DESIRED STATEMNT AND WHEN WE PLACE THAT ON THE PC MANUALLY, COMPILER EXECUTES
THAT INSTRUCTION.(NEED TO CHECK)->PUT AN ADDRESS OF ANY STSEMNT IN PC, AND WHEN CLICKING NEXT INSTRUCTION VERIFY THAT
THE EXECUTION WHETHER JUMPS TO THAT POS. EG:CLICKING JUST BEFORE WHILE GIVES ITS ADDRESS.

THE CURRENTLY EXECUTING LINE CAN BE SEEN ON THE TOP WITH A YELLO HIGHLIGHT ON IT. ALSO THAT LINES ADDRESS IS NOW IN THE 
PROGRAM COUNTER(PC).

TO CREATE A STACK TO STORE THE ADDRESS OF THESE NXT STATEMNT AND OUR STATEMNT SO THAT IT DOESNT AFFECT THE PROCESSOR WORKING, 
IT NEEEDS TO BE LIKE THE REAL STACK ABOVE.
(1<<24 BIT OF XPSR SETS MCOREX IN THUMB MODE).


*/


#include "stm32f4xx.h"             // DEVICE HEADER

#define RED (1<<14)               //SETTING THE PIN14 AS RED
#define RED_BIT (1<<28)          //SETTING RED AS OUTPUT BIT(29:28=0:1)

#define GREEN (1<<12)
#define GREEN_BIT (1<<24)

#define BLUE (1<<15)
#define BLUE_BIT (1<<30)

#define GPIOD_CLOCK (1<<3)           //3RD PIN SETS THE CLOCK ACESS TO D PORT

volatile uint32_t tick;              //THIS VARIABLE MUSTBE VOLATILE,BCZ, VOLATILE VALUE CAN BE
                                    //CHNGED WITHOUT CHNGING IT IN CODE.ALSO VARIBLES USED IN AN 
											             // INTRRPT HANDLER ALSO SHOULB BE A VOLATILE
volatile uint32_t _tick;           //TICK IS USED TO INCREMNT TICK, AND _TICK TO STORE THE TICK AT EACH GET VALUE,
                                   //AND PASSSED THUS I ANYCASE THE ORIGINAL TICK IS NOT AFFECTED


void SysTick_Handler(void){          //THIS FUNCTION EXISTS ON ALL CORTEX M SERIES

	++tick;                           //TICK IS INCREMENTED AT EACH SYSTICK INTERRUPT
}                                  

uint32_t getTick(void){
	
	__disable_irq();                  //INTERRUPT IS DISABLED, BCZ DONT WANT ANY INTERRUPT TO EXECUTE IN THE MIDDLE,
	_tick=tick;                      //USING ANOTHER VARIABLE, SO THAT THE ORIGINAL TICK VARIABLE SHOULDNT BE ALTERED
	__enable_irq();                  //AFTER THE ASSIGNING, 
	
	return _tick;
}

void Dely(uint32_t sec){
	
  sec*=100;                            //MULTIPLY IT WITH SECONDS TO GET THE MILLISECONDS
	uint32_t temp=getTick();            //GETTING THE VALUE OF TICK AT THE STARTING.
  while((getTick()-temp)<sec);       //THEDIFFRENCE B/W THE STARTING AND CURRENT TICK DIFFERNCE
                                    //	GIVES THE TICK TAKEN AFTER THE DELAY IS CALLED
   		                             //THE WHILE FUN WAIT TILL THE DIFERNCE IS GREATER THAN THE DELAY VALUE
}

/*
In this we are creating a delay using for loop ie, without using any timers for 16mhz
*/
void delayMs(int delay)
{
	int i;
	for( ;delay>0;delay--)//thedelay we entered is reduced upto zero
	{
		for(i=0;i<3195;i++);//execution runs for 1ms inside loop
	}
}



void GPIO_Init(){
	
	/******** INITIALIZING GPIO **********/
	
	RCC->AHB1ENR |= GPIOD_CLOCK;         //ENABLING D PORT(BY PROVIDING CLOCK)
	//AHB1ENR:REGISTER TO ENBLE PORTS 
 
  GPIOD->MODER |= RED_BIT|GREEN_BIT|BLUE_BIT;             //SETTING THE CONFIGURATION 01, FOR OUTPUT.
	//MODER:REGISTER TO SET THE PINS AS OUTPUT
	
	
	/******** INITIALIZING TIMER WITH CLOCK **********/
	
	SystemCoreClockUpdate();              //UPDATE WITH CURRENT SYSTEM CLOCK
	SysTick_Config(SystemCoreClock/1000); // CONFIGURE SYSTICK FOR 1ms TICKS
	                                      // CLOCK IS RUNNING IN MHZ RANGE
		
	__enable_irq();                      //TO ENABLE INTERRUPT TO COUNT TICK
}
void RED_BLINK()
{
		while(1)     {	
	  //GPIOD->ODR |= RED|GREEN; 
		//ODR:REGISTER TO SETS THE PINS AS HIGH / LOW
		
		GPIOD->ODR ^= RED;//TO TOGGLE AT EACH SEC
	  /*
		GPIOD->BSRR=1<<14;//SETS THE PIN 14
		delayMs(1000);
		GPIOD->BSRR=1<<30;//RESETS THE PIN 14	
		delayMs(1000);
		*/	
		Dely(1);   }
}
void GREEN_BLINK()
{
		while(1)     {	
	
		GPIOD->ODR ^= GREEN;//TO TOGGLE AT EACH SEC
		Dely(1);   }
}
void BLUE_BLINK()
{
		while(1)     {	
	
		GPIOD->ODR ^= BLUE;//TO TOGGLE AT EACH SEC
		Dely(1);   }
}
int main(){
	
GPIO_Init();
BLUE_BLINK();
}
