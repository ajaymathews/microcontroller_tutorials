#include "stm32f4xx.h"             // DEVICE HEADER
#define RED (1<<14)               //SETTING THE PIN14 AS RED
#define RED_BIT (1<<28)
#define SWITCH_BIT (1<<0)
#define BUTTON_STATUS 0x01
#define GPIOD_CLOCK (1<<3)       //CLOCK TO D PORT
#define GPIOA_CLOCK (1<<0)

void gpio_init()
{
	RCC->AHB1ENR |= GPIOD_CLOCK |GPIOA_CLOCK;//ENABLES THE CLOCK FOR BOTH LED AND SWITCH
	GPIOD->MODER |= RED_BIT;
  
	GPIOA->MODER &= ~SWITCH_BIT;//THIS IS THE METHD TO ASSIGN A ZER0  TO A BIT
	                             //GIVING MODER 0 OR NOT ASSIGNING ANY VALUES IS SAME, BCZ DEFAULT VALUE IS ZERO
}
int main()
{
	gpio_init();

	while(1)
	{
		if((GPIOA->IDR)&BUTTON_STATUS)//CHECKING BUTTON STATUS BY AND OPERATING WITH IDR REGISTER
		{
			while((GPIOA->IDR)&BUTTON_STATUS); //WAITING TILL THE HAND TAKES OFF FROM SWITCH
			
			GPIOD->ODR ^= RED; //TOGGLES LED
		}
  }
}
